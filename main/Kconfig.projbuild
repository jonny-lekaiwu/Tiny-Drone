## main/Kconfig.projbuild
```kconfig
menu "Tiny_Drone Config"

    choice
        prompt "TinyDrone hardware version"
        default TARGET_TINY_DRONE_V1_0 if IDF_TARGET_ESP32S3 
        default TARGET_TINY_DRONE_MINI_V1_0 if IDF_TARGET_ESP32C3 
  
        config TARGET_TINY_DRONE_V1_0
            bool "TinyDrone V1.0"
            depends on IDF_TARGET_ESP32S3

        config TARGET_TINY_DRONE_MINI_V1_0
            bool "TinyDrone Mini V1.0"
            depends on IDF_TARGET_ESP32C3

    endchoice  
    
    menu "app set"
        config ENABLE_LEGACY_APP
            bool "Enable legacy ESPlane1.0 APP"
            default n
            help
                This enables the udp_server_rx2_task of wifi.
        config ENABLE_POSITION_HOLD_MODE
            bool "Enable position hold mode"
            default y
            help
                This enables position hold mode when pmw3901 sensors available.
        config ENABLE_COMMAND_MODE_SET
            bool "Enable \'setCommandermode\' to transform command"
            depends on ENABLE_POSITION_HOLD_MODE
            default y if ENABLE_POSITION_HOLD_MODE
            default n if !ENABLE_POSITION_HOLD_MODE
            help
                This enables assit mode when use old version app.
    endmenu

    menu "wireless config"
        config WIFI_BASE_SSID
            string "Wi-Fi Base SSID"
            default "TINY-DRONE"
            help
                Wi-Fi Base SSID, 1-16 characters. the final SSID will be BASE_SSID-MAC
        config WIFI_PASSWORD
            string "Wi-Fi Password"
            default "87654321"
            help
                Wi-Fi Password, 8-64 characters
        config WIFI_CHANNEL
            int "Wi-Fi/ESP-Now Channel"
            range 1 13
            default 6
            help
                Wi-Fi/ESP-Now Channel, 1-13
        config WIFI_MAX_STA_CONN
            int "Wi-Fi Max Station Connection"
            range 1 6
            default 3
            help
                Wi-Fi Max Station Connection, 1-6
 
        config REMOTE_ID_REGISTRATION_ID
            string "Real-name registration ID (last 8 characters)"
            depends on REMOTE_ID_ENABLE
            default ""
            help
                Last 8 characters issued by the UOM real-name registration system.
                Leave empty only for bench testing; the transmitted field is then NULL-filled.

    endmenu

    menu "calibration angle"
        config PITCH_CALIB
            int "PITCH_CALIB deg*100"
            range -200 200
            default 0
            help
                if PITCH error angle is 0.90,set this 90

        config ROLL_CALIB
            int "ROLL_CALIB deg*100"
            range -200 200
            default 0
            help
                if ROLL error angle is 0.90,set this 90
    endmenu

    menu "system"

        config BASE_STACK_SIZE
            int "base stack size for system task"
            range 512 1024
            default 1024 if IDF_TARGET_ESP32S3
            default 512 if IDF_TARGET_ESP32C3 

    endmenu
 
    menu "sensors config"
        config MPU_PIN_SDA
            int "MPU_PIN_SDA GPIO number"
            range -1 50 if TARGET_TINY_DRONE_V1_0
            default 10 if TARGET_TINY_DRONE_V1_0
            range -1 21 if TARGET_TINY_DRONE_MINI_V1_0
            default 2 if TARGET_TINY_DRONE_MINI_V1_0 
            help
                GPIO number (IOxx) MPU_PIN_SDA

        config MPU_PIN_SCL
            int "MPU_PIN_SCL GPIO number"
            range -1 50 if TARGET_TINY_DRONE_V1_0
            default 11 if TARGET_TINY_DRONE_V1_0
            range -1 21 if TARGET_TINY_DRONE_MINI_V1_0
            default 1 if TARGET_TINY_DRONE_MINI_V1_0 
            help
                GPIO number (IOxx) MPU_PIN_SCL
 
        config MPU_PIN_INT
            int "MPU_PIN_INT GPIO number"
            range -1 50 if TARGET_TINY_DRONE_V1_0
            default 12 if TARGET_TINY_DRONE_V1_0
            range -1 21 if TARGET_TINY_DRONE_MINI_V1_0
            default 8 if TARGET_TINY_DRONE_MINI_V1_0 
            help
                GPIO number (IOxx) MPU_PIN_INT

        config ZRANGE_PIN_SDA
            int "ZRANGE_PIN_SDA GPIO number"
            range -1 50 if TARGET_TINY_DRONE_V1_0
            default 48 if TARGET_TINY_DRONE_V1_0
            range -1 21 if TARGET_TINY_DRONE_MINI_V1_0
            default -1 if TARGET_TINY_DRONE_MINI_V1_0 
            help
                GPIO number (IOxx) ZRANGE_PIN_SDA

        config ZRANGE_PIN_SCL
            int "ZRANGE_PIN_SCL GPIO number"
            range -1 50 if TARGET_TINY_DRONE_V1_0
            default 45 if TARGET_TINY_DRONE_V1_0
            range -1 21 if TARGET_TINY_DRONE_MINI_V1_0
            default -1 if TARGET_TINY_DRONE_MINI_V1_0 
            help
                GPIO number (IOxx) ZRANGE_PIN_SCL

        config SPI_PIN_MISO
            int "SPI_PIN_MISO GPIO number"
            range -1 50 if TARGET_TINY_DRONE_V1_0
            default 21 if TARGET_TINY_DRONE_V1_0
            range -1 21 if TARGET_TINY_DRONE_MINI_V1_0
            default -1 if TARGET_TINY_DRONE_MINI_V1_0 
            help
                GPIO number (IOxx) SPI_PIN_MISO

        config SPI_PIN_MOSI
            int "SPI_PIN_MOSI GPIO number"
            range -1 50 if TARGET_TINY_DRONE_V1_0
            default 13 if TARGET_TINY_DRONE_V1_0
            range -1 21 if TARGET_TINY_DRONE_MINI_V1_0
            default -1 if TARGET_TINY_DRONE_MINI_V1_0 
            help
                GPIO number (IOxx) SPI_PIN_MOSI

        config SPI_PIN_CLK
            int "SPI_PIN_CLK GPIO number"
            range -1 50 if TARGET_TINY_DRONE_V1_0
            default 47 if TARGET_TINY_DRONE_V1_0
            range -1 21 if TARGET_TINY_DRONE_MINI_V1_0
            default -1 if TARGET_TINY_DRONE_MINI_V1_0 
            help
                GPIO number (IOxx) SPI_PIN_CLK

        config SPI_PIN_CS0
            int "SPI_PIN_CS0 GPIO number"
            range -1 50 if TARGET_TINY_DRONE_V1_0
            default 14 if TARGET_TINY_DRONE_V1_0
            range -1 21 if TARGET_TINY_DRONE_MINI_V1_0
            default -1 if TARGET_TINY_DRONE_MINI_V1_0 
            help
                GPIO number (IOxx) SPI_PIN_CS0  

        config ADC1_PIN
            int "ADC1_PIN GPIO number"
            range -1 50 if TARGET_TINY_DRONE_V1_0
            default 1 if TARGET_TINY_DRONE_V1_0
            range -1 21 if TARGET_TINY_DRONE_MINI_V1_0
            default 1 if TARGET_TINY_DRONE_MINI_V1_0 
            help
                GPIO number (IOxx) ADC1_PIN
    endmenu

    menu "led config"
        config LED_PIN_BLUE
            int "LED_PIN_BLUE GPIO number"
            range -1 50 if TARGET_TINY_DRONE_V1_0
            default 5 if TARGET_TINY_DRONE_V1_0
            range -1 21 if TARGET_TINY_DRONE_MINI_V1_0
            default 32 if TARGET_TINY_DRONE_MINI_V1_0 
            help
                GPIO number (IOxx) LED_PIN_BLUE 

    endmenu

    menu "motors config"
        choice
            prompt "Motor type"
            default MOTOR_BRUSHED_715 
            
            config MOTOR_BRUSHED_715
                bool "brushed 715 motor"
    
            config MOTOR_BRUSHED_720
                bool "brushed 720 motor"
        endchoice

        config MOTOR01_PIN
            int "MOTOR01_PIN GPIO number"
            range -1 50 if TARGET_TINY_DRONE_V1_0
            default 3 if TARGET_TINY_DRONE_V1_0
            range -1 21 if TARGET_TINY_DRONE_MINI_V1_0
            default 0 if TARGET_TINY_DRONE_MINI_V1_0 
            help
                GPIO number (IOxx) MOTOR01_PIN

        config MOTOR02_PIN
            int "MOTOR02_PIN GPIO number"
            range -1 50 if TARGET_TINY_DRONE_V1_0
            default 4 if TARGET_TINY_DRONE_V1_0
            range -1 21 if TARGET_TINY_DRONE_MINI_V1_0
            default 3 if TARGET_TINY_DRONE_MINI_V1_0 
            help
                GPIO number (IOxx) MOTOR02_PIN

        config MOTOR03_PIN
            int "MOTOR03_PIN GPIO number"
            range -1 50 if TARGET_TINY_DRONE_V1_0
            default 42 if TARGET_TINY_DRONE_V1_0
            range -1 21 if TARGET_TINY_DRONE_MINI_V1_0
            default 6 if TARGET_TINY_DRONE_MINI_V1_0 
            help
                GPIO number (IOxx) MOTOR03_PIN

        config MOTOR04_PIN
            int "MOTOR04_PIN GPIO number"
            range -1 50 if TARGET_TINY_DRONE_V1_0
            default 41 if TARGET_TINY_DRONE_V1_0
            range -1 21 if TARGET_TINY_DRONE_MINI_V1_0
            default 10 if TARGET_TINY_DRONE_MINI_V1_0 
            help
                GPIO number (IOxx) MOTOR04_PIN
    endmenu


endmenu
```
